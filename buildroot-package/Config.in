## buildroot-package/Config.in
```kconfig
config BR2_PACKAGE_PRUDYNT_T
	bool "Prudynt-T streamer"
	select BR2_PACKAGE_FAAC
	select BR2_PACKAGE_INGENIC_LIB
	select BR2_PACKAGE_INGENIC_MUSL if BR2_TOOLCHAIN_USES_MUSL
	select BR2_PACKAGE_INGENIC_LIBIMP_CONTROL
	select BR2_PACKAGE_JSON_FOR_MODERN_CPP
	select BR2_PACKAGE_THINGINO_LIVE555
	select BR2_PACKAGE_THINGINO_FREETYPE if !BR2_PACKAGE_PRUDYNT_T_NG
	select BR2_PACKAGE_THINGINO_FONTS
	select BR2_PACKAGE_THINGINO_OPUS
	select BR2_PACKAGE_LIBHELIX_AAC
	depends on !(BR2_SOC_FAMILY_INGENIC_A1)
	depends on BR2_TOOLCHAIN_GCC_AT_LEAST_4_9 # C++11 for nlohmann/json
	depends on BR2_INSTALL_LIBSTDCPP
	help
	  Video streamer for Ingenic T-series.
	  Now uses JSON configuration format instead of libconfig.

	  https://github.com/gtxaspec/prudynt-t

config BR2_PACKAGE_PRUDYNT_T_NG
	bool "Prudynt NG"
	depends on BR2_PACKAGE_PRUDYNT_T
	select BR2_PACKAGE_LIBSCHRIFT
	select BR2_PACKAGE_LIBWEBSOCKETS
	help
	  Use Next Generation experimental version of Prudynt-T streamer.
	  This version uses JSON configuration format.

	  https://github.com/Lu-Fi/prudynt-t

comment "prudynt-t needs a toolchain w/ C++, gcc >= 4.9"
	depends on !BR2_INSTALL_LIBSTDCPP || !BR2_TOOLCHAIN_GCC_AT_LEAST_4_9
```
